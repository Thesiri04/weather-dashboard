## esp32-project/sdkconfig.defaults
```kconfig
# ESP-IDF Configuration File
# Configuration for ESP32 DHT11 Sensor Project

# WiFi Configuration
CONFIG_ESP_WIFI_SSID="Jessica13"
CONFIG_ESP_WIFI_PASSWORD="Thesiri01"

# HTTP Client Configuration
CONFIG_ESP_HTTP_CLIENT_ENABLE_HTTPS=y
CONFIG_ESP_TLS_INSECURE=y
CONFIG_ESP_TLS_SKIP_SERVER_CERT_VERIFY=y

# FreeRTOS Configuration
CONFIG_FREERTOS_HZ=1000

# Log Level Configuration
CONFIG_LOG_DEFAULT_LEVEL_INFO=y
CONFIG_LOG_DEFAULT_LEVEL=3

# Main Task Stack Size
CONFIG_ESP_MAIN_TASK_STACK_SIZE=8192

# Network Stack
CONFIG_LWIP_DNS_SUPPORT_MDNS_QUERIES=y
```
